#include<reg52.h>
sbit SPK = P1 ^ 2; //定义音乐输出端口unsigned 
char t; // 休止符标志unsigned 
char w; // 节拍选择 
unsigned char Timer0_H,Timer0_L,Time; //致爱丽丝
unsigned char MUSIC[] = { 3, 2, 1, 2, 2, 1, 3, 2, 1, 2, 2, 1, 3, 2, 1, 7, 1, 1, 2, 2, 1, 1, 2, 1, 6, 1, 2, 6, 0, 1, 1, 1, 1, 3, 1, 1, 6, 1, 1, 7, 1, 2, 5, 0, 1, 3, 1, 1, 5, 1, 1, 7, 1, 1, 1, 2, 2, 6, 1, 1, 3, 1, 1, 3, 2, 1, 2, 2, 1, 3, 2, 1, 2, 2, 1, 3, 2, 1, 7, 1, 1, 2, 2, 1, 1, 2, 1, 6, 1, 2, 6, 0, 1, 1, 1, 1, 3, 1, 1, 6, 1, 1, 7, 1, 2, 5, 0, 1, 3, 1, 1, 5, 1, 1, 7, 1, 1, 6, 1, 2, 6, 0, 1, 7, 1, 1, 1, 2, 1, 2, 1, 1, 3, 1, 2, 1, 1, 1, 5, 1, 1, 4, 2, 1, 3, 2, 1, 2, 2, 2, 7, 0, 1, 4, 1, 1, 3, 2, 1, 2, 2, 1, 1, 2, 2, 6, 0, 1, 3, 1, 1, 2, 2, 1, 1, 2, 1, 7, 0, 1, 3, 1, 1, 3, 1, 1, 3, 2, 1, 3, 1, 1, /* 3,2,1, 3,2,1, 3,3,1, 2,2,1, 3,2,1, 2,3,1, //高音 3,3,1, 2,2,1, 3,2,1, 2,3,1, 3,3,1, 2,3,1, 3,3,1, 2,3,1, 3,3,1, 7,2,1, 2,3,1, 1,3,1, */ 3, 2, 1, 3, 2, 1, 3, 2, 1, 2, 2, 1, 3, 2, 1, 2, 2, 1, //低音 3,2,1, 2,2,1, 3,2,1, 2,2,1, 3,2,1, 2,2,1, 3,2,1, 2,2,1, 3,2,1, 7,1,1, 2,2,1, 1,2,1, 6,2,2, 6,1,1, 1,2,1, 3,2,1, 6,2,1, 7,2,2, 5,1,1, 3,2,1, 5,2,1, 7,2,1, 1,3,2, 6,1,1, 3,2,1, 3,3,1, 2,3,1, 3,3,1, 2,3,1, 3,3,1, 7,2,1, 2,3,1, 1,3,1, 6,2,2, 6,1,1, 1,2,1, 3,2,1, 6,2,1, 7,2,2, 5,2,1, 3,2,1, 1,3,1, 7,2,1, 6,2,4, 6,2,4, 11 }; // 音阶频率表 高八位code
unsigned char FREQH[] = { 0xF2, 0xF3, 0xF5, 0xF5, 0xF6, 0xF7, 0xF8, 0xF9, 0xF9, 0xFA, 0xFA, 0xFB, 0xFB, 0xFC, 0xFC, 0xFC, 0xFD, 0xFD, 0xFD, 0xFD, 0xFE, //1,2,3,4,5,6,7,8,i 0xFE,0xFE,0xFE,0xFE,0xFE,0xFE,0xFF, }; ; // 音阶频率表 低八位code
unsigned char FREQL[] = { 0x42, 0xC1, 0x17, 0xB6, 0xD0, 0xD1, 0xB6, 0x21, 0xE1, 0x8C, 0xD8, 0x68, 0xE9, 0x5B, 0x8F, 0xEE, 0x44, 0x6B, 0xB4, 0xF4, 0x2D, //1,2,3,4,5,6,7,8,i 0x47,0x77,0xA2,0xB6,0xDA,0xFA,0x16, }; 
/*------------------------------------------------ 节拍延时函数 各调1/4节拍时间： 调4/4 125ms 调2/4 250ms ------------------------------------------------*/
void delay_ms() {
  unsigned char i;
  for (i = 0; i < 230; i++);
}
void delay(unsigned char t) {
  unsigned char i;
  for (i = 0; i < t; i++) {
    unsigned int k, j;
    j = 500;
    for (k = 0; k < j; k++) {
      delay_ms();
    }
  }
}
/*------------------------------------------------ 定时器0中断------------------------------------------------*/
void TIM0_ISR() interrupt 1
{ 
  TR0 = 0; if (t != 0) {
  SPK = !SPK;
} else 
{ 
  SPK = 0; 
  TH0 = Timer0_H; 
  TL0 = Timer0_L; 
  TR0 = 1; 
}
/*------------------------------------------------ 歌曲处理函数------------------------------------------------*/
void Song() {
  TH0 = Timer0_H; //赋值定时器时间，决定频率 
  TL0=Timer0_L; 
  TR0=1; //打开定时器 
  delay(Time); //延时所需要的节拍 
  }
  /*------------------------------------------------ 主函数------------------------------------------------*/ 
  void main(void) { 
    unsigned int k,i; 
    TMOD|=0x01; //置定时器0工作方式1 
  EA=1; //打开全局中断 
  ET0=1; //打开定时0中断 
  while(1) 
  { 
    i=0;// w=0; 
  while(MUSIC[i]!=11) { 
    //音乐数组长度 ，唱完从头再来 
    k=MUSIC[i]+7*MUSIC[i+1]-1;//去音符振荡频率所需数据 
    t=MUSIC[i]; 
    Timer0_H=FREQH[k]; 
    Timer0_L=FREQL[k]; 
    Time=MUSIC[i+2]; //节拍时长 
    i=i+3;// 
    w++; 
    Song(); 
    } 
    } 
    }
